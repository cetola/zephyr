## boards/waveshare/rp2350_zero/Kconfig.defconfig
```kconfig
# Copyright (c) 2025 Stephano Cetola
# SPDX-License-Identifier: Apache-2.0

if BOARD_RP2350_ZERO

config USB_SELF_POWERED
	default n

if I2C_DW

config I2C_DW_CLOCK_SPEED
	default 125

endif # I2C_DW

endif # BOARD_RP2350_ZERO
```

## boards/waveshare/rp2350_zero/rp2350_zero_rp2350a_m33_defconfig
```kconfig
# SPDX-License-Identifier: Apache-2.0

CONFIG_BUILD_OUTPUT_UF2=y
CONFIG_CLOCK_CONTROL=y
CONFIG_SYS_CLOCK_HW_CYCLES_PER_SEC=150000000
CONFIG_CONSOLE=y
CONFIG_UART_CONSOLE=y
CONFIG_UART_INTERRUPT_DRIVEN=y
CONFIG_SERIAL=y
CONFIG_USE_DT_CODE_PARTITION=y
CONFIG_GPIO=y
CONFIG_RESET=y
CONFIG_WS2812_STRIP_RPI_PICO_PIO=y
```
